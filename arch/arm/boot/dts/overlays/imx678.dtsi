// Fragment that configures a Sony IMX519

cam_node: imx678@49 {
	compatible = "sony,imx678";
	reg = <0x49>;
	status = "disabled";

	clocks = <&cam1_clk>;
	clock-names = "xclk";

	VANA-supply = <&cam1_reg>;	/* 3.0v */
	VDIG-supply = <&cam_dummy_reg>;	/* 1.8v */
	VDDL-supply = <&cam_dummy_reg>;	/* 1.1v */

	rotation = <0>;
	orientation = <2>;

	port {
		cam_endpoint: endpoint {
			clock-lanes = <0>;
			data-lanes = <1 2>;
			clock-noncontinuous;
			link-frequencies =
				/bits/ 64 <1440000000>;
		};
	};
};
